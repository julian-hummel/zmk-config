// This file was generated from a template. Edit it to match your keyboard.
// See https://zmk.dev/docs/development/hardware-integration/new-shield for more
// instructions.

#include "sleeky.dtsi"

&kscan {
    col-gpios
        = <&pro_micro 18 GPIO_ACTIVE_HIGH>  // Col 0
        , <&pro_micro 15 GPIO_ACTIVE_HIGH>  // Col 1
        , <&pro_micro 14 GPIO_ACTIVE_HIGH>  // Col 2
        , <&pro_micro 16 GPIO_ACTIVE_HIGH>  // Col 3
        , <&pro_micro 10 GPIO_ACTIVE_HIGH>  // Col 4
        ;
};
