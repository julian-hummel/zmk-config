## boards/shields/sleeky/Kconfig.defconfig
```kconfig
if SHIELD_SLEEKY_LEFT

config ZMK_KEYBOARD_NAME
    default "sleeky"

config ZMK_SPLIT_ROLE_CENTRAL
    default y

endif # SHIELD_SLEEKY_LEFT

if SHIELD_SLEEKY_LEFT || SHIELD_SLEEKY_RIGHT

config ZMK_SPLIT
    default y

endif # SHIELD_SLEEKY_LEFT || SHIELD_SLEEKY_RIGHT
```
